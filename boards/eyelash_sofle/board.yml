## boards/eyelash_sofle/board.yml
```yaml
boards:
  - name: eyelash_sofle_left
    vendor: eyelashperipherals
    socs:
      - name: nrf52840
  - name: eyelash_sofle_right
    vendor: eyelashperipherals
    socs:
      - name: nrf52840
```

## config/west.yml
```yaml
manifest:
  remotes:
    - name: zmkfirmware
      url-base: https://github.com/zmkfirmware
    - name: mctechnology17
      url-base: https://github.com/mctechnology17
  projects:
    - name: zmk-nice-oled
      remote: mctechnology17
      revision: main
    - name: zmk
      remote: zmkfirmware
      revision: main
      import: app/west.yml
  self:
    path: boards
```
